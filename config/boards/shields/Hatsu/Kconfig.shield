## config/boards/shields/Hatsu/Kconfig.shield
```kconfig
# Copyright (c) 2020 Pete Johanson
# SPDX-License-Identifier: MIT

config SHIELD_AM_HATSU_LEFT
	def_bool $(shields_list_contains,am_hatsu_left)
```
